## conf/bblayers.conf
```bitbake
POKY_BBLAYERS_CONF_VERSION = "2"

BBPATH = "${TOPDIR}"
BSPDIR := "${@os.path.abspath(os.path.dirname(d.getVar('FILE', True)) + '/..')}"

BBFILES ?= ""
BBLAYERS = " \
  ${BSPDIR}/poky/meta \
  ${BSPDIR}/poky/meta-poky \
  \
  ${BSPDIR}/meta-openembedded/meta-oe \
  ${BSPDIR}/meta-openembedded/meta-networking \
  ${BSPDIR}/meta-openembedded/meta-python \
  \
  ${BSPDIR}/meta-freescale \
  ${BSPDIR}/meta-freescale-3rdparty \
  \
  ${BSPDIR}/meta-local \
"
```

## conf/local.conf
```bitbake
# OE build configuration for CuBox-i
#
# See poky/meta-yocto/conf/local.conf.sample.extended for additional options
# available.
#

# Personalized settings (optional)
include personal.conf

# Default distro & machine to build for
DISTRO ?= "poky"
MACHINE ?= "cubox-i"

# Accept the Freescale EULA for meta-fsl-xxx
ACCEPT_FSL_EULA = "1"

# Package Management configuration
# Options are: package_deb package_ipk package_rpm
PACKAGE_CLASSES = "package_ipk"

# SDK/ADT target architecture
# Supported values are: i686 x86_64
SDKMACHINE ?= "x86_64"

# Configure a local source mirror
SOURCE_MIRROR_URL = "${DL_MIRROR}/"
INHERIT += "${@'own-mirrors' if SOURCE_MIRROR_URL != '/' else ''}"

# Where to place meta data parser cache
PERSISTENT_DIR = "${TOPDIR}/build/cache"

# Where to place shared-state files
SSTATE_DIR = "${TOPDIR}/build/sstate-cache"

# Where to place the build output
TMPDIR = "${TOPDIR}/build/tmp"

# Use the Subversion installed on the build host to avoid repository
# format conflicts
ASSUME_PROVIDED += "subversion-native"

# Parallelism Options
BB_NUMBER_THREADS ?= "${@oe.utils.cpu_count()}"
PARALLEL_MAKE ?= "-j ${@oe.utils.cpu_count()}"

# Create tar-balls of checked out sources (for use by DL_MIRROR)
#BB_GENERATE_MIRROR_TARBALLS = "1"

# Archiving source code configuration
#ARCHIVER_MODE ?= "original"
#ARCHIVER_CLASS = "${@'archive-${ARCHIVER_MODE}-source' if ARCHIVER_MODE != 'none' else ''}"
#INHERIT += "${ARCHIVER_CLASS}"
#SOURCE_ARCHIVE_PACKAGE_TYPE = "tar"

# Generate build history but don't commit to local git repo
INHERIT += "buildhistory"
BUILDHISTORY_COMMIT = "0"
BUILDHISTORY_DIR = "${TOPDIR}/build/history"

#
# Extra image configuration defaults
#
# The EXTRA_IMAGE_FEATURES variable allows extra packages to be added to the generated 
# images. Some of these options are added to certain image types automatically. The
# variable can contain the following options:
#  "dbg-pkgs"       - add -dbg packages for all installed packages
#                     (adds symbol information for debugging/profiling)
#  "dev-pkgs"       - add -dev packages for all installed packages
#                     (useful if you want to develop against libs in the image)
#  "ptest-pkgs"     - add -ptest packages for all ptest-enabled packages
#                     (useful if you want to run the package test suites)
#  "tools-sdk"      - add development tools (gcc, make, pkgconfig etc.)
#  "tools-debug"    - add debugging tools (gdb, strace)
#  "eclipse-debug"  - add Eclipse remote debugging support
#  "tools-profile"  - add profiling tools (oprofile, exmap, lttng, valgrind)
#  "tools-testapps" - add useful testing tools (ts_print, aplay, arecord etc.)
#  "debug-tweaks"   - make an image suitable for development
#                     e.g. ssh root access has a blank password
# There are other application targets that can be used here too, see
# meta/classes/image.bbclass and meta/classes/core-image.bbclass for more details.
EXTRA_IMAGE_FEATURES = "debug-tweaks"

#
# Additional image features
#
# The following is a list of additional classes to use when building images which
# enable extra features. Some available options which can be included in this variable 
# are:
#   - 'buildstats' collect build statistics
#   - 'image-mklibs' to reduce shared library files size for an image
#   - 'image-prelink' in order to prelink the filesystem image
#   - 'image-swab' to perform host system intrusion detection
# NOTE: if listing mklibs & prelink both, then make sure mklibs is before prelink
# NOTE: mklibs also needs to be explicitly enabled for a given image, see local.conf.extended
# MAKR NOTE: image-mklibs will cause problems if updated packages use more library functions.
# MAKR NOTE: image-prelink is done at image build time, upgraded packages will not benefit
#            unless it is re-run on target after every upgrade.
USER_CLASSES ?= "buildstats"

#
# Interactive shell configuration
#
# Under certain circumstances the system may need input from you and to do this it 
# can launch an interactive shell. It needs to do this since the build is 
# multithreaded and needs to be able to handle the case where more than one parallel
# process may require the user's attention. The default is iterate over the available
# terminal types to find one that works.
#
# Examples of the occasions this may happen are when resolving patches which cannot
# be applied, to use the devshell or the kernel menuconfig
#
# Supported values are auto, gnome, xfce, rxvt, screen, konsole (KDE 3.x only), none
# Note: currently, Konsole support only works for KDE 3.x due to the way
# newer Konsole versions behave
#OE_TERMINAL = "auto"
# By default disable interactive patch resolution (tasks will just fail instead):
PATCHRESOLVE = "noop"

#
# Disk Space Monitoring during the build
#
# Monitor the disk space during the build. If there is less that 1GB of space or less
# than 100K inodes in any key build location (TMPDIR, DL_DIR, SSTATE_DIR), gracefully
# shutdown the build. If there is less that 100MB or 1K inodes, perform a hard abort
# of the build. The reason for this is that running completely out of space can corrupt
# files and damages the build in ways which may not be easily recoverable.
BB_DISKMON_DIRS = "\
    STOPTASKS,${TMPDIR},1G,100K \
    STOPTASKS,${DL_DIR},1G,100K \
    STOPTASKS,${SSTATE_DIR},1G,100K \
    ABORT,${TMPDIR},100M,1K \
    ABORT,${DL_DIR},100M,1K \
    ABORT,${SSTATE_DIR},100M,1K" 

# CONF_VERSION is increased each time build/conf/ changes incompatibly and is used to
# track the version of this file when it was generated. This can safely be ignored if
# this doesn't mean anything to you.
CONF_VERSION = "1"
```

## meta-local/conf/layer.conf
```bitbake
# We have a conf and classes directory, add to BBPATH
BBPATH .= ":${LAYERDIR}"

# We have a packages directory, add to BBFILES
BBFILES += "${LAYERDIR}/recipes-*/*/*.bb \
            ${LAYERDIR}/recipes-*/*/*.bbappend"

BBFILE_COLLECTIONS += "local"
BBFILE_PATTERN_local := "^${LAYERDIR}/"
BBFILE_PRIORITY_local = "10"

# Set a variable for recipe reference to layer top dir
LOCALDIR = "${LAYERDIR}"
```

## meta-local/conf/machine/magicmirror.conf
```bitbake
#@TYPE: Machine
#@NAME: Magic Mirror based on SolidRun HummingBoard
#@SOC: i.MX6 DL/Q
#@DESCRIPTION: Machine configuration for SolidRun HummingBoard based magic mirror machine
#@MAINTAINER: Mats Karrman <mats-dev-list@gmail.com>

# They all use the same machine config, since the u-boot SPL autodetects the
# machine type upon booting. SOC_FAMILY includes all SoCs from all of these machines
# to let recipes include firmware etc. for all of these SoCs.

MACHINEOVERRIDES =. "mx6:mx6dl:mx6q:"

#IMX_DEFAULT_BSP = "nxp"
IMX_DEFAULT_BSP = "mainline"

require conf/machine/include/imx-base.inc
require conf/machine/include/tune-cortexa9.inc

PREFERRED_PROVIDER_virtual/kernel = "linux-magicmirror"
#PREFERRED_PROVIDER_virtual/kernel = "${IMX_DEFAULT_KERNEL}"

UBOOT_MACHINE ?= "mx6cuboxi_defconfig"
UBOOT_MAKE_TARGET = "all"
UBOOT_SUFFIX = "img"
SPL_BINARY = "SPL"
WKS_FILE = "imx-uboot-spl-bootpart.wks.in"

KERNEL_IMAGETYPE = "zImage"
KERNEL_DEVICETREE = "imx6dl-cubox-i.dtb imx6q-cubox-i.dtb imx6dl-hummingboard.dtb imx6q-hummingboard.dtb"

#MACHINE_FEATURES += "pci wifi alsa serial usbhost"
MACHINE_FEATURES = "wifi alsa serial usbhost vfat"
#MACHINE_EXTRA_RRECOMMENDS += "bcm4330-nvram-config bcm4329-nvram-config"

SERIAL_CONSOLE = "115200 ttymxc0"
```
